## drivers/gpu/drm/lg1314/Kconfig
```kconfig
# SPDX-License-Identifier: GPL-2.0
config DRM_LG1314
	tristate "DRM support for LG1314 OLED display"
	depends on DRM && OF
	depends on ARCH_LG1K || COMPILE_TEST
	select DRM_CLIENT_SELECTION
	select DRM_GEM_DMA_HELPER
	select DRM_KMS_HELPER
	help
	  DRM/KMS driver for the LG1314 (M19) display pipeline
	  (OSD -> DE -> OVI -> VX1 -> WRGB OLED) used in 2019 LG B9
	  OLED TVs such as the OLED55B9PLA.

	  If M here, the module is called lg1314-drm.
```

## drivers/media/platform/lg/Kconfig
```kconfig
# SPDX-License-Identifier: GPL-2.0-only

comment "LG media platform drivers"

config VIDEO_LG1314_HDMIRX
	tristate "LG1314 HDMI receiver"
	depends on V4L_PLATFORM_DRIVERS
	depends on VIDEO_DEV && I2C
	depends on VIDEO_LG_HAWK2
	depends on ARCH_LG1K || COMPILE_TEST
	select MEDIA_CONTROLLER
	select VIDEO_V4L2_SUBDEV_API
	help
	  The HDMI inputs of the LG1314 (M19) TV SoC: four Synopsys
	  DesignWare HDMI RX 2.0 controllers with LG PHYs, as V4L2
	  subdevices (EDID, hotplug, link lock, DV timings).

config VIDEO_LG_HAWK2
	tristate "LG HAWK2 HDMI 2.1 switch"
	depends on I2C && GPIOLIB && OF
	depends on ARCH_LG1K || COMPILE_TEST
	help
	  The HDMI 2.1 switch in front of the SoC's HDMI receivers on
	  LG's 2019 OLED TVs. It serves EDID and hotplug to the sources
	  and forwards the selected one to the SoC.
```

## drivers/net/wireless/mediatek/mt76/mt7668/Kconfig
```kconfig
# SPDX-License-Identifier: ISC
config MT7668U
	tristate "MediaTek MT7668U (USB) support"
	select MT76_USB
	select MT76_CONNAC_LIB
	depends on MAC80211
	depends on USB
	help
	  This adds support for the Wi-Fi function of MT7668U 802.11ac 2x2:2
	  Wi-Fi/Bluetooth combo devices.

	  To compile this driver as a module, choose M here.
```

## drivers/soc/lg/Kconfig
```kconfig
# SPDX-License-Identifier: GPL-2.0-only

menu "LG SoC drivers"

config LG1314_VDEC
	tristate "LG1314 video-decode coprocessor"
	depends on ARCH_LG1K || COMPILE_TEST
	depends on OF && HAS_DMA
	depends on VIDEO_DEV
	select GENERIC_ALLOCATOR
	select V4L2_MEM2MEM_DEV
	select VIDEOBUF2_DMA_CONTIG
	select VIDEOBUF2_VMALLOC
	help
	  Driver for the Xtensa video-decode coprocessor on the LG1314 TV
	  SoC: loads the decode firmware into a reserved DRAM carveout,
	  boots the coprocessor, and talks to it over a shared-memory
	  mailbox. Provides a V4L2 stateful (memory-to-memory) video
	  decoder, and the firmware's console as /dev/ttyLXIPC0.

	  Say Y here to enable hardware video decode on LG1314-based TVs.

config LG1314_VDEC_PASSTHROUGH
	bool "Raw decoder interface (development only)"
	depends on LG1314_VDEC
	help
	  Adds /dev/lxvdec, which forwards the firmware's own decoder
	  commands from userspace unchanged and maps its stream and
	  notification buffers. This is a development aid for working out
	  the firmware's decode protocol; it is not a stable interface and
	  gives root direct control of the decoder.

	  If unsure, say N.

endmenu
```
